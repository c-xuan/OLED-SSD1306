#include <SPI.h>
#include <Wire.h>
#include <Adafruit_GFX.h>
#include <Adafruit_SSD1306.h>
#include <Pin_define.h>
#include <Bounce2.h>

#define buttonDown PIN23
#define buttonEnter PIN24
#define buttonUp PIN25
#define DS PIN12
#define STCP PIN11
#define SHCP PIN5
#define LED PIN15

#define SCREEN_WIDTH 128  // OLED 寬度像素
#define SCREEN_HEIGHT 64  // OLED 高度像素

#define OLED_RESET -1        // Reset pin # (or -1 if sharing Arduino reset pin)
#define SCREEN_ADDRESS 0x3C  ///< See datasheet for Address; 0x3D for 128x64, 0x3C for 128x32
Adafruit_SSD1306 display(SCREEN_WIDTH, SCREEN_HEIGHT, &Wire, OLED_RESET);
static const unsigned char PROGMEM logo_bmp[] = {

  0x00, 0x00, 0x00, 0x00, 0x00, 0x00, 0x00, 0x00, 0x00, 0x00, 0x00, 0x00,
  0x00, 0x00, 0x00, 0x00, 0x00, 0x00, 0x00, 0x00, 0x00, 0x00, 0x00, 0x00,
  0x00, 0x00, 0x00, 0x00, 0x00, 0x00, 0x00, 0x00, 0x00, 0x00, 0x00, 0x00,
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  0x00, 0x00, 0x00, 0x00
};

Bounce Down = Bounce();
Bounce Up = Bounce();
Bounce Enter = Bounce();

// 菜單項目
const char* mainMenu[]{ "FAN", "GYR" };
const int numItem = sizeof(mainMenu) / sizeof(mainMenu[0]);

const char* fanMenu[]{ "pig", "Gogyr", "Back" };
const int numFanItem = sizeof(fanMenu) / sizeof(fanMenu[0]);

const char* gyrMenu[]{ "cow", "GoFan", "Back" };
const int numGyrItem = sizeof(gyrMenu) / sizeof(gyrMenu[0]);

bool inFan = false;
bool inGyr = false;
int mainselected = 0;
int entered = -1;

void IC(byte value) {
  digitalWrite(STCP, 0);
  shiftOut(DS, SHCP, MSBFIRST, value);
  digitalWrite(STCP, 1);
}

void btn(int lol) {
  int temp = numItem;
  if (lol == 0) {
    temp--;
  }
  if (mainselected < temp) {
    if (Down.fell()) {
      IC(1);
      mainselected++;
    }
  }
  if (mainselected > 0) {
    if (Up.fell()) {
      IC(1);
      mainselected--;
    }
  }
  if (Enter.fell()) {
    IC(1);
    if (inFan == true) {
      if (mainselected == 0) {
        display.clearDisplay();
        display.drawBitmap(0, 0, logo_bmp, 128, 48, 1);
        display.display();
        delay(3000);
      } else if (mainselected == 1) {
        entered = 1;
      } else {
        entered = -1;
      }
      inFan = false;
    } else if (inGyr == true) {
      if (mainselected == 0) {

      } else if (mainselected == 1) {
        entered = 0;
      } else {
        entered = -1;
      }
      inGyr = false;
    } else {
      entered = mainselected;
    }
    mainselected = 0;
  }
}
void Fan_display(void) {
  inFan = true;
  btn(1);

  display.clearDisplay();
  display.setTextSize(2);    // 設定文字大小
  display.setTextColor(1);   // 1:OLED預設的顏色(這個會依該OLED的顏色來決定)
  display.setCursor(42, 0);  // 設定起始座標
  display.print("FAN");      // 要顯示的字串
  for (int i = 0; i < numFanItem; i++) {
    if (i == mainselected) {
      display.setTextColor(BLACK, WHITE);
    } else {
      display.setTextColor(WHITE);
    }
    display.setCursor(46, 15 + i * 15);  // 每行顯示一個項目
    display.println(fanMenu[i]);
  }
  display.display();  // 要有這行才會把文字顯示出來
}

void Gyr_display() {
  inGyr = true;
  btn(1);

  display.clearDisplay();
  display.setTextSize(2);    // 設定文字大小
  display.setTextColor(1);   // 1:OLED預設的顏色(這個會依該OLED的顏色來決定)
  display.setCursor(42, 0);  // 設定起始座標
  display.print("GYR");      // 要顯示的字串
  for (int i = 0; i < numGyrItem; i++) {
    if (i == mainselected) {
      display.setTextColor(BLACK, WHITE);
    } else {
      display.setTextColor(WHITE);
    }
    display.setCursor(46, 15 + i * 15);  // 每行顯示一個項目
    display.println(gyrMenu[i]);
  }
  display.display();  // 要有這行才會把文字顯示出來
}

void menu_display(void) {
  btn(0);
  display.clearDisplay();
  display.setTextSize(2);    // 設定文字大小
  display.setTextColor(1);   // 1:OLED預設的顏色(這個會依該OLED的顏色來決定)
  display.setCursor(42, 0);  // 設定起始座標
  display.println("Menu");   // 要顯示的字串
  for (int i = 0; i < numItem; i++) {
    if (i == mainselected) {
      display.setTextColor(BLACK, WHITE);
    } else {
      display.setTextColor(WHITE);
    }
    display.setCursor(46, 20 + i * 20);  // 每行顯示一個項目
    display.println(mainMenu[i]);
  }
  display.display();  // 要有這行才會把文字顯示出來
}

void setup() {
  pinMode(LED, OUTPUT);
  pinMode(DS, OUTPUT);
  pinMode(STCP, OUTPUT);
  pinMode(SHCP, OUTPUT);
  IC(0);

  //Up
  Up.attach(buttonUp, INPUT);
  Up.interval(5);
  //Down
  Down.attach(buttonDown, INPUT);
  Down.interval(5);
  //Enter
  Enter.attach(buttonEnter, INPUT);
  Enter.interval(5);

  Serial.begin(9600);
  if (!display.begin(SSD1306_SWITCHCAPVCC, SCREEN_ADDRESS)) {
    Serial.println(F("SSD1306 allocation failed"));
    for (;;)
      ;  // Don't proceed, loop forever
  }
  display.clearDisplay();
  display.setTextSize(2);
  display.setTextColor(1);
  display.setCursor(42, 0);
  display.print("NKHS");
  display.setCursor(42, 40);
  display.print("C206");
  display.display();
  delay(2000);
}

void loop() {
  Up.update();
  Down.update();
  Enter.update();
  IC(0);
  if (entered == -1)
    menu_display();
  else if (entered == 0)
    Fan_display();
  else if (entered == 1)
    Gyr_display();
}
